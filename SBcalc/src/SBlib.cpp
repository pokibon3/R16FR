// SBclib.cpp : soroban calculator library
// 2023.07.07  JA1AOQ/K.Ohe
//
#include <Arduino.h>

#include "SBlib.hpp"

const uint8_t LEDMATRIX_CS_PIN    = 10;                          // CS
const int     LEDMATRIX_SEGMENTS  = 4;                           // 4 keta
const int     LEDMATRIX_WIDTH     = LEDMATRIX_SEGMENTS * 8;      // 8 dots

// The LEDMatrixDriver class instance
LEDMatrixDriver lmd(LEDMATRIX_SEGMENTS, LEDMATRIX_CS_PIN);

uint8_t soroban[10] = {
    0b10001111,         // 0
    0b10010111,         // 1
    0b10011011,         // 2
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    0b01011110,         // 9
};

// This is the font definition. You can use http://gurgleapps.com/tools/matrix to create your own font or sprites.
byte font[95][8] = { {0,0,0,0,0,0,0,0}, // SPACE
                     {0x10,0x18,0x18,0x18,0x18,0x00,0x18,0x18}, // EXCL
                     {0x28,0x28,0x08,0x00,0x00,0x00,0x00,0x00}, // QUOT
                     {0x00,0x0a,0x7f,0x14,0x28,0xfe,0x50,0x00}, // #
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                     {0x00,0x7c,0x04,0x08,0x7c,0x20,0x40,0xfe}, // Z
                      // (the font does not contain any lower case letters. you can add your own.)
                  };    // {}, //


void SBclear()
{
    //SBclearAnimation()
    lmd.clear();
    lmd.display();
}

void SBclearAnimation()
{
    for (int x = 0; x < 32; x++) {
        dispSoroban(5, x);
        delay(5);
    }
    for (int x = 0; x < 32; x++) {
        dispSoroban(0, x);
        delay(5);
    }
}

void dispSoroban(uint8_t num, int16_t col)
{
    uint8_t col_mask = 0b10000000;
    //Serial.println(num);
    for (int i = 0; i < 8; i++) {
        if (col_mask & soroban[num]) {
        lmd.setPixel(col , i , true);
        } else {
        lmd.setPixel(col , i , false);
        }
        lmd.display();
        delay(1);
        col_mask >>= 1;
    }
}

void led_test()
{
    for (int x = 0; x < 32; x++) {
        for (int y = 0; y < 8; y++) {
        lmd.setPixel(x , y , true );
        lmd.display();
        delay(5);
        }
    }
    for (int x = 0; x < 32; x++) {
        for (int y = 0; y < 8; y++) {
        lmd.setPixel(x , y , false );
        lmd.display();
        delay(5);
        }
    }
}

/**
 * This function draws a string of the given length to the given position.
 */
void drawString(const char* text, int len, int x, int y )
{
    for( int idx = 0; idx < len; idx ++ )
    {
        int c = text[idx] - 32;

        // stop if char is outside visible area
        if( x + idx * 8  > LEDMATRIX_WIDTH )
        return;

        // only draw if char is visible
        if( 8 + x + idx * 8 > 0 )
        drawSprite( font[c], x + idx * 8, y, 8, 8 );
    }
    lmd.display();
}

/**
 * This draws a sprite to the given position using the width and height supplied (usually 8x8)
 */
void drawSprite( byte* sprite, int x, int y, int width, int height )
{
    // The mask is used to get the column bit from the sprite row
    byte mask = B10000000;

    for( int iy = 0; iy < height; iy++ )
    {
        for( int ix = 0; ix < width; ix++ )
        {
        lmd.setPixel(x + ix, y + iy, (bool)(sprite[iy] & mask ));

        // shift the mask by one pixel to the right
        mask = mask >> 1;
        }

        // reset column mask
        mask = B10000000;
    }
}